## project/boards/esp32c6_supermini/Kconfig.esp32c6_supermini
```kconfig
# ESP32-C6-Mini board configuration

# Copyright (c) 2025 Siratul Islam
# SPDX-License-Identifier: Apache-2.0

config BOARD_ESP32C6_SUPERMINI
	select SOC_ESP32_C6_WROOM_1U_N4
	select SOC_ESP32C6_HPCORE if BOARD_ESP32C6_SUPERMINI_ESP32C6_HPCORE
	select SOC_ESP32C6_LPCORE if BOARD_ESP32C6_SUPERMINI_ESP32C6_LPCORE
```

## project/boards/esp32c6_supermini/board.yml
```yaml
board:
  name: esp32c6_supermini
  full_name: WeAct Studio ESP32-C6-Mini
  vendor: weact
  socs:
    - name: esp32c6
```
